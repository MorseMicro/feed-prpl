## network/plugins/wan-autosensing/Config.in
```kconfig
config PACKAGE_wan-autosensing
    tristate
    select SAH_AMX_WAN_AUTOSENSING

if PACKAGE_wan-autosensing

menu "Select wan-autosensing build options"
    depends on PACKAGE_wan-autosensing

config SAH_AMX_WAN_AUTOSENSING
    bool "Build a tr181 compatible WAN autosensing plugin"
    default y

config SAH_AMX_WAN_AUTOSENSING_ORDER
    int "WAN Autosensing plugin start up order"
    default 90

endmenu

endif
```

## network/plugins/wan-manager/Config.in
```kconfig
config PACKAGE_wan-manager
    tristate
    select SAH_AMX_WAN_MANAGER

if PACKAGE_wan-manager

menu "Select wan-manager build options"
    depends on PACKAGE_wan-manager

config SAH_AMX_WAN_MANAGER
    bool "Build a tr181 compatible time plugin"
    default y

config SAH_AMX_WAN_MANAGER_ORDER
    int "WAN manager plugin start up order"
    default 80

config SAH_AMX_WAN_MANAGER_RUN_AS_USER
    string "User will be used for the WAN-MANAGER plugin"
    default "tr181_app"

config SAH_AMX_WAN_MANAGER_RUN_AS_GROUP
    string "Group will be used for the WAN-MANAGER plugin"
    default "tr181_app"

endmenu

endif
```

## prplmesh/Config.in
```kconfig
config USE_PRPLMESH_WHM
    bool "Use prplMesh Wireless Hardware Manager"
    default n

config PRPLMESH_ENABLE_AMBIORIX_UBUS_BACKEND
    bool "Enable usage of Ambiorix ubus backend"
    default y

config PRPLMESH_ENABLE_UNIT_TESTS
    bool "Enable build of unit tests"

config PRPL_CONTROLLER_ROOT_PATH
    string "Default prplmesh Datamodel path"
    default "Device.WiFi.DataElements"
    depends on PACKAGE_prplmesh
    help
        Set the root datamodel to be used, by default will be set to Device.WiFi.DataElements, unless if any project changes 
        it to something else.
        This may be helpful when several third-party packages have something in Device.WiFi.
```

## prplmesh/plugins/pwhm/Config.in
```kconfig
config PACKAGE_pwhm
    tristate
    select SAH_SERVICES_PWHM

if PACKAGE_pwhm

menu "Select pwhm build options"
    depends on PACKAGE_pwhm

config SAH_SERVICES_PWHM
    bool "Build pwhm itself"
    default y

config USE_SAH_WPS_FORCE_EQUAL_WL_UUID
    bool "Create WPS UUID based AP MAC address"
    default n

config USE_SAH_WPS_DEVICE_NAME
    bool "Force a WPS custom device name in WPS IE"
    default n

config SAH_WPS_DEVICE_NAME
    string "WPS IE device Name string"
    default "SAH_WPS_DeviceName"
    depends on USE_SAH_WPS_DEVICE_NAME

config USE_SAH_WPS_FRIENDLY_NAME
    bool "Force a WPS custom friendly name in WPS IE"
    default n

config SAH_WPS_FRIENDLY_NAME
    string "WPS IE Friendly Name string"
    default "SAH_WPS_FriendlyName"
    depends on USE_SAH_WPS_FRIENDLY_NAME

config SAH_WLD_INIT_LEGACY
    bool "Legacy: Init wld from vendor plugin"
    default n

config SAH_WLD_INIT_SCRIPT
    string "Generic plugin init script name"
    default "wld_gen"
    depends on !SAH_WLD_INIT_LEGACY

config SAH_WLD_INIT_ORDER
    int "Generic plugin init order"
    default 60
    depends on !SAH_WLD_INIT_LEGACY

config SAH_WLD_ENABLE_USP_SERVER_SOCKET
    bool "Enable direct USP server socket"
    default n

endmenu

endif
```

## tr69/libraries/libtr69-engine/Config.in
```kconfig
config PACKAGE_libtr69-engine
    tristate
    select SAH_LIB_TR069_ENGINE

if PACKAGE_libtr69-engine

menu "Select libtr69-engine build options"
    depends on PACKAGE_libtr69-engine

config SAH_LIB_TR069_ENGINE
    bool "Build TR069 Engine"
    default y

config SAH_SERVICES_TR069_DISABLE_XML_PROLOG
    bool "Disable XML Prolog for dmxmlparser lib"
    default n

endmenu

endif
```

## tr69/plugins/tr069-manager/Config.in
```kconfig
config PACKAGE_tr069-manager
    tristate
    select SAH_AMX_TR069_MANAGER

if PACKAGE_tr069-manager

menu "Select tr069-manager build options"
    depends on PACKAGE_tr069-manager

config SAH_AMX_TR069_MANAGER
    bool "Build TR069 Manager"
    default y

config SAH_AMX_TR069_MANAGER_ORDER
    int "TR069 Manager start up order"
    default 98

config SAH_AMX_TR069_MANAGER_CERTIFICATE_NO_PEM
    bool "Allow not to use any certificate"
    default n

endmenu

endif
```

## network/plugins/netdev-plugin/Config.in
```kconfig
config PACKAGE_netdev-plugin
    tristate
    select SAH_AMX_NETDEV

if PACKAGE_netdev-plugin

menu "Select netdev-plugin build options"
    depends on PACKAGE_netdev-plugin

config SAH_AMX_NETDEV
    bool "Build NetDev"
    default y

config SAH_AMX_NETDEV_64_BITS_NETWORK_STATISTICS
    bool "Use 64 bit network statistics instead of 32 bit"
    default n

config SAH_AMX_NETDEV_BROKEN_NETLINK
    bool "Map the unknown operating state to up on all interfaces"
    default n

config SAH_AMX_NETDEV_RUN_AS_USER
    string "User will be used for the NETDEV plugin"
    default "tr181_app"

config SAH_AMX_NETDEV_RUN_AS_GROUP
    string "Group will be used for the NETDEV plugin"
    default "tr181_app"

endmenu

endif
```

## network/plugins/netmodel/Config.in
```kconfig
config PACKAGE_netmodel
    tristate
    select SAH_AMX_NETMODEL

if PACKAGE_netmodel

menu "Select netmodel build options"
    depends on PACKAGE_netmodel

config SAH_AMX_NETMODEL
    bool "Build the Network Model plugin"
    default y

config SAH_AMX_NETMODEL_ORDER
    int "Network Model plugin startup order"
    default 20

endmenu

endif
```

## network/plugins/packet-interception/Config.in
```kconfig
config PACKAGE_packet-interception
    tristate
    select SAH_AMX_PACKET-INTERCEPTION

if PACKAGE_packet-interception

menu "Select packet-interception build options"
    depends on PACKAGE_packet-interception

config SAH_AMX_PACKET-INTERCEPTION
    bool "Build a packet interception component"
    default y

config SAH_AMX_PACKET_INTERCEPTION_ORDER
    int "Start up order"
    default 50

endmenu

endif
```

## network/plugins/pcm-manager/Config.in
```kconfig
config PACKAGE_pcm-manager
    tristate
    select SAH_AMX_PCM

if PACKAGE_pcm-manager

menu "Select pcm-manager build options"
    depends on PACKAGE_pcm-manager

config SAH_AMX_PCM
    bool "Upgrade persistent configuration manager"
    default y

config SAH_AMX_PCM_ORDER
    int "Start order of the TR-181 persistent configuration manager"
    default 17

config SAH_AMX_PCM_TARBALL
    bool "Configure the feature for generating a tarball file for the user's backup files"
    default y

config SAH_AMX_PCM_RUN_AS_USER
    string "User will be used for the PCM-MANAGER plugin"
    default "tr181_app"

config SAH_AMX_PCM_RUN_AS_GROUP
    string "Group will be used for the PCM-MANAGER plugin"
    default "tr181_app"

endmenu

endif
```

## network/plugins/routing-manager/Config.in
```kconfig
config PACKAGE_routing-manager
    tristate
    select SAH_AMX_TR181_ROUTING

if PACKAGE_routing-manager

menu "Select routing-manager build options"
    depends on PACKAGE_routing-manager

config SAH_AMX_TR181_ROUTING
    bool "TR-181 Routing"
    default y

config SAH_AMX_TR181_ROUTING_RUN_AS_USER
    string "User will be used for the ROUTING-MANAGER plugin"
    default "tr181_app"

config SAH_AMX_TR181_ROUTING_RUN_AS_GROUP
    string "Group will be used for the ROUTING-MANAGER plugin"
    default "tr181_app"

endmenu

endif
```

## network/plugins/ssh-server/Config.in
```kconfig
config PACKAGE_ssh-server
    tristate
    select SAH_AMX_SSH_SERVER

if PACKAGE_ssh-server

menu "Select ssh-server build options"
    depends on PACKAGE_ssh-server

config SAH_AMX_SSH_SERVER
    bool "Build ssh server plugin"
    default y

config SAH_AMX_SSH_SERVER_ORDER
    int "start up order of ssh server plugin"
    default 25

config SAH_AMX_SSH_SERVER_SOP
    bool "Build ssh server plugin for SOP"
    default n

endmenu

endif
```

## network/plugins/time-manager/Config.in
```kconfig
config PACKAGE_time-manager
    tristate
    select SAH_AMX_TR181_TIME

if PACKAGE_time-manager

menu "Select time-manager build options"
    depends on PACKAGE_time-manager

config SAH_AMX_TR181_TIME
    bool "Build a tr181 compatible time plugin"
    default y

config SAH_AMX_TR181_TIME_ORDER
    int "tr181 time plugin start up order"
    default 30

endmenu

endif
```

## network/plugins/tr181-bridging/Config.in
```kconfig
config PACKAGE_tr181-bridging
    tristate
    select SAH_AMX_TR181_BRIDGING

if PACKAGE_tr181-bridging

menu "Select tr181-bridging build options"
    depends on PACKAGE_tr181-bridging

config SAH_AMX_TR181_BRIDGING
    bool "Build the TR-181 compatible bridging manager"
    default y

config SAH_AMX_TR181_BRIDGING_RUN_AS_USER
    string "User will be used for the bridging manager plugin"
    default "tr181_app"

config SAH_AMX_TR181_BRIDGING_RUN_AS_GROUP
    string "Group will be used for the bridging manager plugin"
    default "tr181_app"

endmenu

endif
```

## network/plugins/tr181-button/Config.in
```kconfig
config PACKAGE_tr181-button
    tristate
    select SAH_AMX_TR181_BUTTON

if PACKAGE_tr181-button

menu "Select tr181-button build options"
    depends on PACKAGE_tr181-button

config SAH_AMX_TR181_BUTTON
    bool "Build tr181-button itself"
    default y

config SAH_AMX_TR181_BUTTON_ORDER
    int "Start up order for the tr181 button plugin"
    default 42

endmenu

endif
```

## network/plugins/tr181-device/Config.in
```kconfig
config PACKAGE_tr181-device
    tristate
    select SAH_AMX_TR181_DEVICE

if PACKAGE_tr181-device

menu "Select tr181-device build options"
    depends on PACKAGE_tr181-device

config SAH_AMX_TR181_DEVICE
    bool "Build a tr181 compatible device plugin"
    default y

config SAH_AMX_TR181_DEVICE_ORDER
    int "Start up order for the tr181 device plugin"
    default 41

endmenu

endif
```

## network/plugins/tr181-dhcpv4client/Config.in
```kconfig
config PACKAGE_tr181-dhcpv4client
    tristate
    select SAH_AMX_TR181_DHCPV4CLIENT

if PACKAGE_tr181-dhcpv4client

menu "Select tr181-dhcpv4client build options"
    depends on PACKAGE_tr181-dhcpv4client

config SAH_AMX_TR181_DHCPV4CLIENT
    bool "Build TR-181 compatible DHCPv4 client"
    default y

config SAH_AMX_TR181_DHCPV4CLIENT_RUN_AS_USER
    string "User will be used for the TR-181 DHCPV4CLIENT plugin"
    default "tr181_app"

config SAH_AMX_TR181_DHCPV4CLIENT_RUN_AS_GROUP
    string "Group will be used for the TR-181 DHCPV4CLIENT plugin"
    default "tr181_app"

endmenu

endif
```

## network/plugins/tr181-dns/Config.in
```kconfig
config PACKAGE_tr181-dns
    tristate
    select SAH_AMX_TR181_DNS

if PACKAGE_tr181-dns

menu "Select tr181-dns build options"
    depends on PACKAGE_tr181-dns

config SAH_AMX_TR181_DNS
    bool "Build a tr181 compatible dns plugin"
    default y

config SAH_AMX_TR181_DNS_ORDER
    int "Start up order for the tr181 dns plugin"
    default 30

endmenu

endif
```

## network/plugins/tr181-dnssd/Config.in
```kconfig
config PACKAGE_tr181-dnssd
    tristate
    select SAH_AMX_TR181_DNSSD

if PACKAGE_tr181-dnssd

menu "Select tr181-dnssd build options"
    depends on PACKAGE_tr181-dnssd

config SAH_AMX_TR181_DNSSD
    bool "Build a tr181 compatible dns service discovery plugin"
    default y

config SAH_AMX_TR181_DNSSD_ORDER
    int "Start up order for the tr181 dns service discovery plugin"
    default 31

endmenu

endif
```

## network/plugins/tr181-dslite/Config.in
```kconfig
config PACKAGE_tr181-dslite
    tristate
    select SAH_AMX_TR181_DSLITE

if PACKAGE_tr181-dslite

menu "Select tr181-dslite build options"
    depends on PACKAGE_tr181-dslite

config SAH_AMX_TR181_DSLITE
    bool "Build tr181 compatible dslite plugin"
    default y

config SAH_AMX_TR181_DSLITE_ORDER
    int "Start up order for the tr181 dslite plugin"
    default 42

config SAH_AMX_TR181_DSLITE_CARES_RPATH
    bool "Enable linking and setting rpath to /opt/prplos"
    default y

endmenu

endif
```

## network/plugins/tr181-firewall/Config.in
```kconfig
config PACKAGE_tr181-firewall
    tristate
    select SAH_AMX_TR181_FIREWALL

if PACKAGE_tr181-firewall

menu "Select tr181-firewall build options"
    depends on PACKAGE_tr181-firewall

config SAH_AMX_TR181_FIREWALL
    bool "Build a tr181 compatible firewall manager"
    default y

config SAH_AMX_TR181_FIREWALL_ORDER
    int "Start up order"
    default 22

config SAH_AMX_TR181_FIREWALL_RUN_AS_USER
    string "User will be used for the tr181-firewall plugin"
    default "tr181_app"

config SAH_AMX_TR181_FIREWALL_RUN_AS_GROUP
    string "Group will be used for the tr181-firewall plugin"
    default "tr181_app"

config SAH_AMX_TR181_FIREWALL_WITH_GMAP
    bool "Compile tr181-firewall with gmap to support hostname translation."
    default y

endmenu

endif
```

## network/plugins/tr181-httpaccess/Config.in
```kconfig
config PACKAGE_tr181-httpaccess
    tristate
    select SAH_AMX_TR181_HTTPACCESS

if PACKAGE_tr181-httpaccess

menu "Select tr181-httpaccess build options"
    depends on PACKAGE_tr181-httpaccess

config SAH_AMX_TR181_HTTPACCESS
    bool "Build HTTPAccess data model plug-in"
    default y

config SAH_AMX_TR181_HTTPACCESS_ORDER
    int "TR-181 HTTPAccess plugin start order"
    default 49

endmenu

endif
```

## network/plugins/tr181-led/Config.in
```kconfig
config PACKAGE_tr181-led
    tristate
    select SAH_AMX_TR181_LED

if PACKAGE_tr181-led

menu "Select tr181-led build options"
    depends on PACKAGE_tr181-led

config SAH_AMX_TR181_LED
    bool "Build a tr181 compatible leds manager"
    default y

config SAH_AMX_TR181_LED_ORDER
    int "Start up order"
    default 15

endmenu

endif
```

## network/plugins/tr181-logical/Config.in
```kconfig
config PACKAGE_tr181-logical
    tristate
    select SAH_AMX_TR181_LOGICAL

if PACKAGE_tr181-logical

menu "Select tr181-logical build options"
    depends on PACKAGE_tr181-logical

config SAH_AMX_TR181_LOGICAL
    bool "Build a tr181 compatible logical plugin"
    default y

config SAH_AMX_TR181_LOGICAL_ORDER
    int "Start up order for the tr181 logical plugin"
    default 21

endmenu

endif
```

## network/plugins/tr181-neighbordiscovery/Config.in
```kconfig
config PACKAGE_tr181-neighbordiscovery
    tristate
    select SAH_AMX_TR181_NEIGHBORDISCOVERY

if PACKAGE_tr181-neighbordiscovery

menu "Select tr181-neighbordiscovery build options"
    depends on PACKAGE_tr181-neighbordiscovery

config SAH_AMX_TR181_NEIGHBORDISCOVERY
    bool "Build a tr181 compatible neighbordiscovery plugin"
    default y

config SAH_AMX_TR181_NEIGHBORDISCOVERY_ORDER
    int "Start up order for the tr181-NEIGHBORDISCOVERY plugin"
    default 50

config SAH_AMX_TR181_NEIGHBORDISCOVERY_RUN_AS_USER
    string "User will be used for the TR181-NEIGHBORDISCOVERY plugin"
    default "tr181_app"

config SAH_AMX_TR181_NEIGHBORDISCOVERY_RUN_AS_GROUP
    string "Group will be used for the TR181-NEIGHBORDISCOVERY plugin"
    default "tr181_app"

endmenu

endif
```

## network/plugins/tr181-pcp/Config.in
```kconfig
config PACKAGE_tr181-pcp
    tristate
    select SAH_AMX_TR181_PCP

if PACKAGE_tr181-pcp

menu "Select tr181-pcp build options"
    depends on PACKAGE_tr181-pcp

config SAH_AMX_TR181_PCP
    bool "Build tr181 pcp plug-in"
    default y

config SAH_AMX_TR181_PCP_ORDER
    int "Start up order for the tr181 pcp plugin"
    default 70

config SAH_AMX_TR181_PCP_CARES_RPATH
    bool "Enable linking and setting rpath to /opt/prplos"
    default n

endmenu

endif
```

## network/plugins/tr181-qos/Config.in
```kconfig
config PACKAGE_tr181-qos
    tristate
    select SAH_AMX_TR181_QOS

if PACKAGE_tr181-qos

menu "Select tr181-qos build options"
    depends on PACKAGE_tr181-qos

config SAH_AMX_TR181_QOS
    bool "Build A TR-181 Compatible QOS manager"
    default y

config SAH_AMX_TR181_QOS_ORDER
    int "TR-181 QoS plugin start order"
    default 49

endmenu

endif
```

## network/plugins/tr181-security/Config.in
```kconfig
config PACKAGE_tr181-security
    tristate
    select SAH_AMX_TR181_SECURITY

if PACKAGE_tr181-security

menu "Select tr181-security build options"
    depends on PACKAGE_tr181-security

config SAH_AMX_TR181_SECURITY
    bool "Build a tr181 compatible security plugin"
    default y

config SAH_AMX_TR181_SECURITY_ORDER
    int "Start up order for the tr181 SECURITY plugin"
    default 61

endmenu

endif
```

## network/plugins/tr181-upnp/Config.in
```kconfig
config PACKAGE_tr181-upnp
    tristate
    select SAH_AMX_TR181_UPNP

if PACKAGE_tr181-upnp

menu "Select tr181-upnp build options"
    depends on PACKAGE_tr181-upnp

config SAH_AMX_TR181_UPNP
    bool "Build a tr181 compatible upnp manager"
    default y

config SAH_AMX_TR181_UPNP_ORDER
    int "Start up order for the tr181 upnp manager"
    default 80

endmenu

endif
```

## network/plugins/tr181-usermanagement/Config.in
```kconfig
config PACKAGE_tr181-usermanagement
    tristate
    select SAH_AMX_USERMANAGEMENT

if PACKAGE_tr181-usermanagement

menu "Select tr181-usermanagement build options"
    depends on PACKAGE_tr181-usermanagement

config SAH_AMX_USERMANAGEMENT
    bool "Build usermanagement"
    default y

config SAH_AMX_USERMANAGEMENT_ORDER
    int "TR-181 compatible user management plugin"
    default 15

config SAH_AMX_USERMANAGEMENT_DISABLE_SHA512
    bool "Disable SHA512 and use the insecure MD5 instead for hashing passwords"
    default n

endmenu

endif
```

## network/plugins/tr181-xpon/Config.in
```kconfig
config PACKAGE_tr181-xpon
    tristate
    select SAH_AMX_TR181_XPON

if PACKAGE_tr181-xpon

menu "Select tr181-xpon build options"
    depends on PACKAGE_tr181-xpon

config SAH_AMX_TR181_XPON
    bool "Build a TR-181 XPON manager"
    default y

config SAH_AMX_TR181_XPON_ORDER
    int "TR-181 XPON manager start up order"
    default 30

config SAH_AMX_TR181_XPON_MAX_ONUS
    int "Maximum number of ONUs"
    default 1

config SAH_AMX_TR181_XPON_USE_NETDEV_COUNTERS
    bool "Get counters from netdev"
    default n
	help
	  If not enabled the vendor module is responsible for displaying the network statistics in the tr181-xpon datamodel

endmenu

endif
```

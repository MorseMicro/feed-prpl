## ambiorix/apps/amx-fcgi/Config.in
```kconfig
config PACKAGE_amx-fcgi
    tristate
    select SAH_AMX_FCGI

if PACKAGE_amx-fcgi

menu "Select amx-fcgi build options"
    depends on PACKAGE_amx-fcgi

config SAH_AMX_FCGI
    bool "Build Ambiorix Fast CGI"
    default y

config REST_API_WEBUI_DEMO
    bool "Install a demo webui"
    default n

endmenu

endif
```

## ambiorix/libs/libamxrt/Config.in
```kconfig
config PACKAGE_libamxrt
    tristate
    select SAH_LIB_AMXRT

if PACKAGE_libamxrt

menu "Select libamxrt build options"
    depends on PACKAGE_libamxrt

config SAH_LIB_AMXRT
    bool "Build libamxrt"
    default y

config SAH_AMXRT_RWDATAPATH
    string "Persistent storage location"
    default "/opt/prplmesh"

endmenu

endif
```

## ambiorix/mods/mod-ba-cli/Config.in
```kconfig
config PACKAGE_mod-ba-cli
    tristate
    select SAH_MOD_BA_CLI

if PACKAGE_mod-ba-cli

menu "Select mod-ba-cli build options"
    depends on PACKAGE_mod-ba-cli

config SAH_MOD_BA_CLI
    bool "Build Bus Agnostic Command Line Interface Module"
    default y

config SAH_MOD_BA_CLI_INSTALL_UBUS_CLI
    bool "Install ubus cli"
    default y

config SAH_MOD_BA_CLI_INSTALL_PCB_CLI
    bool "Install pcb cli"
    default y

endmenu

endif
```

## ambiorix/mods/mod-lua-amx/Config.in
```kconfig
config PACKAGE_mod-lua-amx
    tristate
    select SAH_MOD-LUA-AMX

if PACKAGE_mod-lua-amx

menu "Select mod-lua-amx build options"
    depends on PACKAGE_mod-lua-amx

config SAH_MOD-LUA-AMX
    bool "Build Ambiorix LUA extension"
    default y

config SAH_LUA_AMX_LUA_VERSION
    string "Lua version that will be used"
    default ""

endmenu

endif
```

## ambiorix/utilities/lua-amx/Config.in
```kconfig
config PACKAGE_lua-amx
    tristate
    select SAH_LUA_AMX

if PACKAGE_lua-amx

menu "Select lua-amx build options"
    depends on PACKAGE_lua-amx

config SAH_LUA_AMX
    bool "Build LUA AMX Bindings"
    default y

config SAH_LUA_AMX_LUA_VERSION_OVERRIDE
    bool "Override default lua version"
    default y

config SAH_LUA_AMX_LUA_VERSION
    string "Lua version that will be used"
    default "NONE"
    depends on SAH_LUA_AMX_LUA_VERSION_OVERRIDE

endmenu

endif
```

## gmap/apps/gmap-client/Config.in
```kconfig
config PACKAGE_gmap-client
    tristate
    select SAH_AMX_GMAP_CLIENT

if PACKAGE_gmap-client

menu "Select gmap-client build options"
    depends on PACKAGE_gmap-client

config SAH_AMX_GMAP_CLIENT
    bool "Build the gMap client plugin"
    default y

config SAH_AMX_GMAP_CLIENT_ORDER
    int "gMap client plugin startup order"
    default 82

config SAH_AMX_GMAP_CLIENT_ONE_PROCESS
    bool "All gMap client modules run in same process"
    default y

endmenu

endif
```

## gmap/apps/gmap-mod-self/Config.in
```kconfig
config PACKAGE_gmap-mod-self
    tristate
    select SAH_SERVICES_GMAP-SELF

if PACKAGE_gmap-mod-self

menu "Select gmap-mod-self build options"
    depends on PACKAGE_gmap-mod-self

config SAH_SERVICES_GMAP-SELF
    bool "Application for filling in the device's and it's interfaces information"
    default y

config SAH_SERVICES_GMAP_SELF_DEVTYPE_WIFIREPEATER
    bool "gmap-self runs on a wifi repeater"
    default n

endmenu

endif
```

## gmap/apps/gmap-server/Config.in
```kconfig
config PACKAGE_gmap-server
    tristate
    select SAH_AMX_GMAP_SERVER

if PACKAGE_gmap-server

menu "Select gmap-server build options"
    depends on PACKAGE_gmap-server

config SAH_AMX_GMAP_SERVER
    bool "Build gMap server"
    default y

config SAH_AMX_GMAP_SERVER_ORDER
    int "gMap server plugin startup order"
    default 71

config AMX_GMAP_SERVER_NAME_ORDER
    string "Priority list of device name sources (highest priority on the left). Source default is implicit and last (after searching alternatives for the device)."
    default "webui,user,dil,tags,mdns,dhcp,lltd,plc,mac,upnp,usb,voice,default"

config AMX_GMAP_MAX_DEVICES
    int "The max number of gmap devices that can be present at the same time"
    default 70

endmenu

endif
```

## lcm/apps/cthulhu/Config.in
```kconfig
config PACKAGE_cthulhu
    tristate
    select SAH_SERVICES_CTHULHU

if PACKAGE_cthulhu

menu "Select cthulhu build options"
    depends on PACKAGE_cthulhu

config SAH_SERVICES_CTHULHU
    bool "Build Cthulhu"
    default y

config SAH_SERVICES_CTHULHU_DATASIZE
    int "Default data size of the generic sandbox (in kb)"
    default 5120

config SAH_SERVICES_CTHULHU_LCM_STORAGE_LOCATION
    string "Default LCM storage location"
    default "/usr/share"

config SAH_SERVICES_CTHULHU_INIT_START
    int "Cthulhu plugin start up order"
    default 99

config SAH_SERVICES_CTHULHU_INIT_STOP
    int "Cthulhu plugin stop order"
    default 60

endmenu

endif
```

## lcm/apps/rlyeh/Config.in
```kconfig
config PACKAGE_rlyeh
    tristate
    select SAH_SERVICES_RLYEH

if PACKAGE_rlyeh

menu "Select rlyeh build options"
    depends on PACKAGE_rlyeh

config SAH_SERVICES_RLYEH
    bool "Build Rlyeh"
    default y

config SAH_SERVICES_RLYEH_LCM_STORAGE_LOCATION
    string "Prefix used to determine the location where the LCM data is stored."
    default "/usr/share"

config SAH_SERVICES_RLYEH_ORDER
    int "Rlyeh plugin start up order"
    default 90

endmenu

endif
```

## lcm/apps/timingila/Config.in
```kconfig
config PACKAGE_timingila
    tristate
    select SAH_SERVICES_TIMINGILA

if PACKAGE_timingila

menu "Select timingila build options"
    depends on PACKAGE_timingila

config SAH_SERVICES_TIMINGILA
    bool "Build TIMINGILA"
    default y

config SAH_SERVICES_TIMINGILA_INIT_START
    int "TIMINGILA plugin start up order"
    default 91

config SAH_SERVICES_TIMINGILA_INIT_STOP
    int "TIMINGILA plugin stop order"
    default 80

config SAH_SERVICES_TIMINGILA_INIT_ADAPTERS
    bool "Init Timingila adapters"
    default y

config SAH_SERVICES_TIMINGILA_ADAPTER_PACKAGER
    string "Timingila adapter packager so path"
    default "/usr/lib/timingila-rlyeh/timingila-rlyeh.so"

config SAH_SERVICES_TIMINGILA_ADAPTER_CONTAINER
    string "Timingila adapter container so path"
    default "/usr/lib/timingila-cthulhu/timingila-cthulhu.so"

endmenu

endif
```

## lcm/mods/cthulhu-lxc/Config.in
```kconfig
config PACKAGE_cthulhu-lxc
    tristate
    select SAH_LIB_CTHULHU-LXC

if PACKAGE_cthulhu-lxc

menu "Select cthulhu-lxc build options"
    depends on PACKAGE_cthulhu-lxc

config SAH_LIB_CTHULHU-LXC
    bool "Build Cthulhu OCI module"
    default y

config SAH_LIB_CTHULHU-LXC_PRPL_OS_RPATH
    bool "Enable linking and setting rpath to /opt/prplos"
    default y

endmenu

endif
```

## netmodel/libs/libnetmodel/Config.in
```kconfig
config PACKAGE_libnetmodel
    tristate
    select SAH_LIB_NETMODEL

if PACKAGE_libnetmodel

menu "Select libnetmodel build options"
    depends on PACKAGE_libnetmodel

config SAH_LIB_NETMODEL
    bool "Build NetModel library"
    default y

config SAH_LIB_NETMODEL_SOP
    bool "Build the Netmodel library for SOP"
    default n

endmenu

endif
```

## netmodel/plugins/netmodel-clients/Config.in
```kconfig
config PACKAGE_netmodel-clients
    tristate
    select SAH_AMX_NETMODEL_CLIENTS

if PACKAGE_netmodel-clients

menu "Select netmodel-clients build options"
    depends on PACKAGE_netmodel-clients

config SAH_AMX_NETMODEL_CLIENTS
    bool "Build the Network Model clients plugin"
    default y

config SAH_AMX_NETMODEL_CLIENTS_ORDER
    int "Network Model clients plugin startup order"
    default 20

config SAH_AMX_NETMODEL_CLIENTS_RUN_AS_USER
    string "User will be used for the NETMODEL-CLIENTS plugin"
    default "tr181_app"

config SAH_AMX_NETMODEL_CLIENTS_RUN_AS_GROUP
    string "Group will be used for the NETMODEL-CLIENTS plugin"
    default "tr181_app"

endmenu

endif
```

## network/libs/libfwinterface/Config.in
```kconfig
config PACKAGE_libfwinterface
    tristate
    select SAH_LIB_FWINTERFACE

if PACKAGE_libfwinterface

menu "Select libfwinterface build options"
    depends on PACKAGE_libfwinterface

config SAH_LIB_FWINTERFACE
    bool "Build the firewall interfaces library"
    default n

choice
    prompt "Choose the interface to use between lib_fwrules and netfilter"
    default SAH_LIB_FWINTERFACE_INTERFACE_IPTC

config SAH_LIB_FWINTERFACE_INTERFACE_DUMMY
    bool "Dummy interface. Does nothing"

config SAH_LIB_FWINTERFACE_INTERFACE_IPTC
    bool "Use lib_iptc as the interface"

endchoice

endmenu

endif
```

## network/libs/libimtp/Config.in
```kconfig
config PACKAGE_libimtp
    tristate
    select SAH_LIB_IMTP

if PACKAGE_libimtp

menu "Select libimtp build options"
    depends on PACKAGE_libimtp

config SAH_LIB_IMTP
    bool "Build the imtp internal message transfer protocol library"
    default y

endmenu

endif
```

## network/libs/libnetlink-utils/Config.in
```kconfig
config PACKAGE_libnetlink-utils
    tristate
    select SAH_LIB_NETLINK_UTILS

if PACKAGE_libnetlink-utils

menu "Select libnetlink-utils build options"
    depends on PACKAGE_libnetlink-utils

config SAH_LIB_NETLINK_UTILS
    bool "Build netlink utility library"
    default y

config SAH_LIB_NETLINK_NF_QUEUE_PRPL_OS_PATH
    bool "Enable linking and setting rpath to /opt/prplos"
    default y

endmenu

endif
```

## network/mods/mod-fw-amx/Config.in
```kconfig
config PACKAGE_mod-fw-amx
    tristate
    select SAH_MOD_FW-AMX

if PACKAGE_mod-fw-amx

menu "Select mod-fw-amx build options"
    depends on PACKAGE_mod-fw-amx

config SAH_MOD_FW-AMX
    bool "Build the tr181-firewall amx module"
    default n

config SAH_MOD_FW-AMX_SOP
    bool "Build the tr181-firewall amx module for SOP"
    default n

endmenu

endif
```

## network/mods/mod-sahtrace/Config.in
```kconfig
config PACKAGE_mod-sahtrace
    tristate
    select SAH_MOD_SAHTRACE

if PACKAGE_mod-sahtrace

menu "Select mod-sahtrace build options"
    depends on PACKAGE_mod-sahtrace

config SAH_MOD_SAHTRACE
    bool "Build Ambiorix sahtrace module"
    default y

config SAH_MOD_SAHTRACE_DEFAULT_LOG_LEVEL
    int "Default log level for mod sahtrace"
    default 200

config SAH_MOD_SAHTRACE_DEFAULT_TRACE_ZONE_LEVEL
    int "Default log level for trace zones in mod sahtrace"
    default 200

endmenu

endif
```

## network/plugins/deviceinfo-manager/Config.in
```kconfig
config PACKAGE_deviceinfo-manager
    tristate
    select SAH_AMX_TR181_DEVICEINFO

if PACKAGE_deviceinfo-manager

menu "Select deviceinfo-manager build options"
    depends on PACKAGE_deviceinfo-manager

config SAH_AMX_TR181_DEVICEINFO
    bool "Build a tr181 compatible device info plugin"
    default y

config SAH_AMX_TR181_DEVICEINFO_ORDER
    int "tr181 deviceinfo Plugin start up order"
    default 25

config SAH_AMX_TR181_ENVIRONMENT_ORDER
    int "Configure env variables order"
    default 15

config SAH_AMX_ADD_SYSINIT_DONE_SCRIPT
    bool "Add sysinit_done script"
    default n

config SAH_AMX_ADD_DBREADY_SCRIPT
    bool "Add dbready script"
    default n

config SAH_AMX_TR181_DEVICEINFO_DEVELOPMENT
    bool "Configure service for development, enable debug features"
    default n

config SAH_AMX_TR181_DEVICEINFO_HARDWARE_VERSION
    string "Configure the hardware version"
    default "XX"

config SAH_AMX_TR181_DEVICEINFO_SOFTWARE_VERSION
    string "Configure the software version"
    default "XX"

config SAH_AMX_TR181_DEVICEINFO_RUN_AS_USER
    string "User will be used for the TR181_DEVICEINFO plugin"
    default "root"

config SAH_AMX_TR181_DEVICEINFO_RUN_AS_GROUP
    string "Group will be used for the TR181_DEVICEINFO plugin"
    default "root"

endmenu

endif
```

## network/plugins/dhcpv6s-manager/Config.in
```kconfig
config PACKAGE_dhcpv6s-manager
    tristate
    select SAH_AMX_TR181_DHCPV6S

if PACKAGE_dhcpv6s-manager

menu "Select dhcpv6s-manager build options"
    depends on PACKAGE_dhcpv6s-manager

config SAH_AMX_TR181_DHCPV6S
    bool "TR-181 Device.DHCPV6.Server. datamodel implementation"
    default y

config SAH_AMX_TR181_DHCPV6S_RUN_AS_USER
    string "User will be used for the DHCPV6S-MANAGER plugin"
    default "tr181_app"

config SAH_AMX_TR181_DHCPV6S_RUN_AS_GROUP
    string "Group will be used for the DHCPV6S-MANAGER plugin"
    default "tr181_app"

endmenu

endif
```

## network/plugins/ethernet-manager/Config.in
```kconfig
config PACKAGE_ethernet-manager
    tristate
    select SAH_AMX_TR181_ETHERNET

if PACKAGE_ethernet-manager

menu "Select ethernet-manager build options"
    depends on PACKAGE_ethernet-manager

config SAH_AMX_TR181_ETHERNET
    bool "Build a tr181 compatible ethernet plugin"
    default y

config SAH_AMX_TR181_ETHERNET_ORDER
    int "Start up order for the tr181 ethernet plugin"
    default 21

config SAH_AMX_TR181_ETHERNET_RUN_AS_USER
    string "User will be used for the tr181-ethernet plugin"
    default "tr181_app"

config SAH_AMX_TR181_ETHERNET_RUN_AS_GROUP
    string "Group will be used for the tr181-ethernet plugin"
    default "tr181_app"

endmenu

endif
```

## network/plugins/ip-manager/Config.in
```kconfig
config PACKAGE_ip-manager
    tristate
    select SAH_AMX_TR181_IP

if PACKAGE_ip-manager

menu "Select ip-manager build options"
    depends on PACKAGE_ip-manager

config SAH_AMX_TR181_IP
    bool "TR-181 Device.IP datamodel implementation"
    default y

config SAH_AMX_TR181_IP_RUN_AS_USER
    string "User will be used for the IP-MANAGER plugin"
    default "tr181_app"

config SAH_AMX_TR181_IP_RUN_AS_GROUP
    string "Group will be used for the IP-MANAGER plugin"
    default "tr181_app"

endmenu

endif
```

## network/plugins/moca-manager/Config.in
```kconfig
config PACKAGE_moca-manager
    tristate
    select SAH_AMX_TR181_MOCA

if PACKAGE_moca-manager

menu "Select moca-manager build options"
    depends on PACKAGE_moca-manager

config SAH_AMX_TR181_MOCA
    bool "Build a tr181 compatible moca plugin"
    default y

config SAH_AMX_TR181_MOCA_ORDER
    int "Start up order for the tr181 moca plugin"
    default 25

endmenu

endif
```

## network/plugins/multisettings/Config.in
```kconfig
config PACKAGE_multisettings
    tristate
    select SAH_AMX_MULTISETTINGS

if PACKAGE_multisettings

menu "Select multisettings build options"
    depends on PACKAGE_multisettings

config SAH_AMX_MULTISETTINGS
    bool "Build a tr181 compatible multisettings plugin"
    default y

config SAH_AMX_MULTISETTINGS_ORDER
    int "Start up order for the tr181 multisettings plugin"
    default 25

endmenu

endif
```
